## boards/arm/cy8ceval_062s2/Kconfig.defconfig
```kconfig
# CY8CEVAL-062S2 PSoC™ 62S2 Evaluation Kit

# Copyright (c) 2021 Cypress Semiconductor Corporation.
# SPDX-License-Identifier: Apache-2.0

if BOARD_CY8CKIT_062S2

config BOARD
	default "cy8ckit_062s2"

if WIFI || BT

# Select AIROC part and module
choice AIROC_PART
	default CYW43439
endchoice

choice CYW43439_MODULE
	default CYW43439_MURATA_1YN
endchoice


endchoice

endif # WIFI || BT

if WIFI

config WIFI_AIROC
	default y

# Enable L2 Ethernet
config NET_L2_ETHERNET
	default y

endif # WIFI

if BT

# Select HCI components
config UART
	bool
	default y

config BT_UART
	default y

choice BT_HCI_BUS_TYPE
	default BT_H4
endchoice

endif # BT

# Heap Pool Size
config HEAP_MEM_POOL_SIZE
	default 15000 if WIFI
	default 4096

endif   # BOARD_CY8CKIT_062S2
```

## boards/arm/nucleo_u5a5zj_q/Kconfig.defconfig
```kconfig
# STM32U5A5ZJ Q Nucleo board configuration

# Copyright (c) 2023 STMicroelectronics
# SPDX-License-Identifier: Apache-2.0

if BOARD_NUCLEO_U5A5ZJ_Q

config BOARD
	default "nucleo_u5a5zj_q"

if BT

choice AIROC_PART
	default BT_AIROC_CUSTOM
endchoice

endif # BT

endif # BOARD_NUCLEO_U5A5ZJ_Q
```

## boards/arm/nucleo_u5a5zj_q/nucleo_u5a5zj_q_defconfig
```kconfig
# SPDX-License-Identifier: Apache-2.0

CONFIG_SOC_SERIES_STM32U5X=y
CONFIG_SOC_STM32U5A5XX=y

# enable uart driver
CONFIG_SERIAL=y

# enable GPIO
CONFIG_GPIO=y

# Enable clock
CONFIG_CLOCK_CONTROL=y

# console
CONFIG_CONSOLE=y
CONFIG_UART_CONSOLE=y

# Enable MPU
CONFIG_ARM_MPU=y

# Enable HW stack protection
CONFIG_HW_STACK_PROTECTION=y

# enable pin controller
CONFIG_PINCTRL=y

CONFIG_PM=y
CONFIG_PM_DEVICE=y
#CONFIG_PM_DEVICE_RUNTIME=y

# When CONFIG_PM_NEED_ALL_DEVICES_IDLE option is enabled, 
# check that no devices are busy before entering into system
# low power mode
CONFIG_PM_NEED_ALL_DEVICES_IDLE=y

# For Debuging in sleep mode
CONFIG_STM32_ENABLE_DEBUG_SLEEP_STOP=y
CONFIG_DEBUG=y   

CONFIG_AIROC_CUSTOM_FIRMWARE_HCD_BLOB="C:/temp/bt_fw/CYW4343A2_001.003.016.0031.0000_Generic_UART_37_4MHz_wlbga_BU_dl_signed.hcd"
```

## dts/bindings/bluetooth/infineon,cyw43xxx-bt-hci.yaml
```yaml
# Copyright (c) 2022 Cypress Semiconductor Corporation (an Infineon company) or
# an affiliate of Cypress Semiconductor Corporation
#
# SPDX-License-Identifier: Apache-2.0

description: |
    CYW43xxx Connectivity that uses Zephyr's Bluetooth Host Controller Interface UART
    driver.

compatible: "infineon,cyw43xxx-bt-hci"

include: base.yaml

properties:
    bt-reg-on-gpios:
      description:
        BT Reg ON gpio
      type: phandle-array
      required: true

    bt-host-wake-gpios:
      description:
        BT Host wakeup gpio
      type: phandle-array

    bt-dev-wake-gpios:
      description:
        BT Device wakeup gpio
      type: phandle-array

    fw-download-speed:
      type: int
      description:
        HCI Uart boudrate for FW dowload operation
      default: 3000000
```

## samples/net/wifi/boards/rpi_pico_rp2040_w.conf
```kconfig
CONFIG_LOG_PROCESS_THREAD_STACK_SIZE=1024
CONFIG_HEAP_MEM_POOL_SIZE=2048
CONFIG_SHELL_STACK_SIZE=2560

CONFIG_WIFI=y

CONFIG_NETWORKING=y
CONFIG_NET_L2_ETHERNET=y

CONFIG_NET_IPV6=n
CONFIG_NET_IPV4=y
CONFIG_NET_DHCPV4=y

CONFIG_NET_LOG=y
CONFIG_WIFI_AIROC=y
CONFIG_AIROC_WIFI_BUS_SDIO=n
CONFIG_AIROC_WIFI_BUS_SPI=y
#CONFIG_INFINEON_ZEPHYR_WIFI=y - we do not need this let's use CONFIG_WIFI_AIROC
CONFIG_CYW43439=y

CONFIG_COMPILER_SAVE_TEMPS=y
```
